## arch/arm/mach-novatek/Kconfig
```kconfig
if ARCH_NOVATEK

choice
	prompt "NovaTek board select"

config TARGET_NA51000
	bool "NovaTek NA51000 family SoC"
	# CPU is V7A with cache line size is 64
	select CPU_V7A
	select ARCH_MISC_INIT
	select MISC_INIT_R
	select NVT_IVOT_SOC
	help
	  The Novatek NA51000 series are the ARM-based SoC with a single core Cortex-A53

config TARGET_NA51000_A64
	bool "NovaTek NA51000 family A64 SoC"
	# CPU is V7A with cache line size is 64
	select ARM64
	select ARCH_MISC_INIT
	select MISC_INIT_R
	select NVT_IVOT_SOC
	help
	  The Novatek NA51000 series are the ARM-based SoC with a single core Cortex-A53

config TARGET_NA51055
	bool "NovaTek NA51055 family SoC"
	# CPU is V7A with cache line size is 32
	select CPU_V7A
	select ARCH_MISC_INIT
	select MISC_INIT_R
	select NVT_IVOT_SOC
	help
	  The Novatek NA51055 series are the ARM-based SoC with a single core Cortex-A9.

config TARGET_NA51068
	bool "NovaTek NA51068 family SoC"
	# CPU is V7A with cache line size is 32
	select CPU_V7A
	select ARCH_MISC_INIT
	select MISC_INIT_R
	select NVT_IVOT_SOC
	help
	  The Novatek NA51068 series are the ARM-based SoC with a dual core Cortex-A9.

config TARGET_NA51089
	bool "NovaTek NA51089 family SoC"
	# CPU is V7A with cache line size is 32
	select CPU_V7A
	select ARCH_MISC_INIT
	select MISC_INIT_R
	select NVT_IVOT_SOC
	help
	  The Novatek NA51089 series are the ARM-based SoC with a single core Cortex-A9.

config TARGET_NA51090
	bool "NovaTek NA51090 family SoC"
	# CPU is V7A with cache line size is 64
	select CPU_V7A
	select ARCH_MISC_INIT
	select MISC_INIT_R
	select NVT_IVOT_SOC
	help
	  The Novatek NA51000 series are the ARM-based SoC with a single core Cortex-A53

config TARGET_NA51090_A64
	bool "NovaTek NA51090 family A64 SoC"
	# CPU is V7A with cache line size is 64
	select ARM64
	select ARCH_MISC_INIT
	select MISC_INIT_R
	select NVT_IVOT_SOC
	help
	  The Novatek NA51000 series are the ARM-based SoC with a single core Cortex-A53

endchoice

config NVT_DISABLE_CFG_CHK
	string
	default y

config SYS_MALLOC_LEN
	hex
	default 0x300000

config NVT_BOARD
	bool
	default y

# To inculde basic arch config
source "arch/arm/mach-novatek/nvt_na51000_a32/Kconfig"
source "arch/arm/mach-novatek/nvt_na51000_a64/Kconfig"
source "arch/arm/mach-novatek/nvt_na51055_a32/Kconfig"
source "arch/arm/mach-novatek/nvt_na51068_a32/Kconfig"
source "arch/arm/mach-novatek/nvt_na51089_a32/Kconfig"
source "arch/arm/mach-novatek/nvt_na51090_a32/Kconfig"
source "arch/arm/mach-novatek/nvt_na51090_a64/Kconfig"
endif
```

## arch/arm/mach-novatek/nvt_na51000_a32/Kconfig
```kconfig
if TARGET_NA51000

config SYS_CONFIG_NAME
	string "Board configuration name"
	default "nvt-na51000-evb"
	help
	  This option contains information about board configuration name.
	  Based on this option include/configs/<CONFIG_SYS_CONFIG_NAME>.h header
	  will be used for board configuration.

#config SYS_TEXT_BASE
#	default 0x00000000

config SYS_BOARD
	default "nvt-na51000"
	help
	  This option contains information about board name.
	  Based on this option board/<CONFIG_SYS_VENDOR>/<CONFIG_SYS_BOARD> will
	  be used.

config SYS_SOC
	default "nvt-na51000_a32"

config NVT_NAND_TYPE
	int "0: ONFINAND, 1: SPINAND, 2:SPINOR"
	depends on (NVT_SPI_NAND || NVT_SPI_NOR)
	default 1

config NVT_NAND_ECC
	int "0: RS-ECC, 1: On-Die ECC"
	depends on (NVT_SPI_NAND || NVT_SPI_NONE)
	default 1

config NVT_IVOT_DDR_SLOW_DOWN_SUPPORT
	bool "To support slow down DDR frequency"
	default n
	help
	  This option is used to change DDR frequency to minimum.

# To include novatek board common config
source "board/novatek/common/Kconfig"
# To include novatek board specific config
source "board/novatek/nvt-na51000/Kconfig"
endif
```

## board/novatek/3rd_party/Kconfig
```kconfig
menu "Novatek 3rd Party Features"
config NVT_RTK_BT_FWLOAD
	bool "Support RTK BT dongle firmware download functions"
	help
	   Support RTK BT dongle firmware download functions


endmenu		# Novatek 3rd Party Features
```

## board/novatek/common/Kconfig
```kconfig
menu "Novatek IVOT features"
config NVT_IVOT_SOC
	bool "Novatek IVOT series soc"
	help
	  This option can be used to enable ivot features.

config NVT_FPGA_EMULATION
	bool "Novatek IVOT FPGA emulation"
	default n
	help
	  This option can be used to enable FPGA emulation.

config NVT_IVOT_SOC_FW_UPDATE_SUPPORT
	bool "Novatek IVOT FW update utils"
	default n
	help
	  This option can be used to support fdt parsing and update api.

config NVT_IVOT_SOC_UTILS
	bool "Novatek IVOT utils"
	default n
	help
	  To support IVOT proprietary utilities.

config NVT_IVOT_NVT_DBG
	bool "Novatek IVOT debug setting"
	default n
	help
	  To support IVOT message debug function.

config NVT_IVOT_DEBUG_LEVEL
	int "Debug msg print level (0-8)"
        default 4
        depends on NVT_IVOT_NVT_DBG
        help
          0 ~ 8: 8 is to turn on all print message

config NVT_IVOT_BOOT_FAST
	bool "Let your uboot booting time faster"
	default n
	help
	  This option can be used to accelerate boot time.

config NVT_IVOT_OPTEE_SUPPORT
	bool "To support the optee utils"
	default n
	help
	  This option is used to communicate with optee secure os.

config NVT_IVOT_OPTEE_SECBOOT_SUPPORT
	bool "To support secure boot flow with optee"
	depends on NVT_IVOT_OPTEE_SUPPORT
	default n
	help
	  To support secure boot flow with optee

config NVT_IVOT_TZPC_SUPPORT
	bool "To support TZPC related utils"
	default n
	help
	  This option is used to simple verify TZPC.

config NVT_IVOT_DDR_RANGE_SCAN_SUPPORT
	bool "To support DDR range scan utils"
	default n
	help
	  This option is used to lunch range scan.

config VIDEO_LOGO
	bool "To support display LOGO"
	default n
	help
	  This option is used to lunch display LOGO.

config NVT_IVOT_CRYPTO_CMD
	bool "To support crypto engine command"
	depends on NVT_IVOT_SOC && NVT_IVOT_OPTEE_SUPPORT=n
	help
	  Novatek iVot Crypto Engine Command support.

config NVT_IVOT_HASH_CMD
	bool "To support hash engine command"
	depends on NVT_IVOT_SOC && NVT_IVOT_OPTEE_SUPPORT=n
	help
	  Novatek iVot Hash Engine Command support.

config NVT_IVOT_RSA_CMD
	bool "To support rsa engine command"
	depends on NVT_IVOT_SOC && NVT_IVOT_OPTEE_SUPPORT=n
	help
	  Novatek iVot RSA Engine Command support.

endmenu		# Novatek IVOT features
```

## board/novatek/nvt-na51090-a64/Kconfig
```kconfig
if TARGET_NA51090_A64

# board/$SYS_VENDOR/$SYS_BOARD
# arch/<CONFIG_SYS_ARCH>/cpu/<CONFIG_SYS_CPU>/<CONFIG_SYS_SOC>.
config SYS_BOARD
	default "nvt-na51090-a64"

config SYS_VENDOR
	default "novatek"

# include/configs/$SYS_CONFIG_NAME
config SYS_CONFIG_NAME
	default "nvt-na51090-evb-a64"

# To setup the uboot system environment store setting
config ENV_SIZE
	hex
	default 0x20000 if ENV_IS_IN_NAND
	default 0x10000 if ENV_IS_IN_SPI_FLASH
	default 0x40000 if ENV_IS_IN_MMC
	default 0x2000 if ENV_IS_NOWHERE

config ENV_OFFSET
	hex
	default 0x3c000 if ENV_IS_IN_NAND
	default 0x00B0000 if ENV_IS_IN_SPI_FLASH
	default 0x002C0000 if ENV_IS_IN_MMC

config ENV_RANGE
	hex
	default 0x40000 if ENV_IS_IN_NAND

config ENV_SECT_SIZE
	hex
	default 0x10000 if ENV_IS_IN_SPI_FLASH

source "board/novatek/nvt-na51090-a64/nvt_pcie/Kconfig"
endif
```

## board/novatek/nvt-na51090-a64/nvt_pcie/Kconfig
```kconfig
if ARCH_NOVATEK
	if TARGET_NA51090_A64 || TARGET_NA51090
		menu "Novatek PCIE features"
		config NVT_PCIE
				bool "NVT PCIE support"

		config NVT_PCIE_MAPPING
				bool "Support for pcie memory mapping"
				depends on NVT_PCIE
				default n
				help
				Enabling this will make a U-Boot binary that is capable of being
				pcie initialization and memory mapping

		config NVT_PCIE_TEST_MODE
				int "NVT PCIE test mode"
				default 1
				depends on NVT_PCIE_MAPPING
				help
					0: test RC loopback (test mode)
					1: test RC side in cascade
					2: test EP side in cascade

		config NVT_PCIE_CASCADE
				bool "Enable 63x pcie cascade"
				depends on NVT_PCIE_MAPPING && TARGET_NA51090_A64
				default n
				help
				This option is used to enable NVT pcie boot ep mode.
		endmenu
	endif # TARGET_NA51090 || TARGET_NA51090_A64
endif # ARCH_NOVATEK
```

## board/novatek/nvt-na51090/nvt_pcie/Kconfig
```kconfig
if ARCH_NOVATEK
	if TARGET_NA51090_A64 || TARGET_NA51090
		menu "Novatek PCIE features"
		config NVT_PCIE
				bool "NVT PCIE support"

		config NVT_PCIE_MAPPING
				bool "Support for pcie memory mapping"
				depends on NVT_PCIE
				default n
				help
				Enabling this will make a U-Boot binary that is capable of being
				pcie memory mapping

		config NVT_PCIE_TEST_MODE
				int "NVT PCIE test mode"
				default 1
				depends on NVT_PCIE_MAPPING
				help
					0: test RC loopback (test mode)
					1: test RC side in cascade
					2: test EP side in cascade

		config NVT_PCIE_CASCADE
				bool "Enable 63x pcie cascade"
				depends on NVT_PCIE && TARGET_NA51090_A64
				default n
				help
				This option is used to enable 63x pcie cascade mode.
		endmenu
	endif # TARGET_NA51090 || TARGET_NA51090_A64
endif # ARCH_NOVATEK
```

## drivers/crypto/Kconfig
```kconfig
menu "Hardware crypto devices"

source drivers/crypto/fsl/Kconfig

if TARGET_NA51055
source drivers/crypto/nvt/na51055/Kconfig
endif

if TARGET_NA51090 || TARGET_NA51090_A64
source drivers/crypto/nvt/na51090/Kconfig
endif

endmenu
```

## drivers/crypto/nvt/na51055/Kconfig
```kconfig
config NVT_CRYPTO
	bool "NovaTek NA51055 Crypto Driver Support"
	help
	  Novatek NA51055 processors have crypto engine accelerator.
	  Select this if you want to use the crypto engine for AES/DES/3DES
	  algorithms.

config NVT_HASH
	bool "NovaTek NA51055 Hash Driver Support"
	help
	  Novatek NA51055 processors have hash engine accelerator.
	  Select this if you want to use the hash engine for SHA1/SHA256 algorithms.

config NVT_RSA
	bool "NovaTek NA51055 RSA Driver Support"
	help
	  Novatek NA51055 processors have rsa engine accelerator.
	  Select this if you want to use the rsa engine.
```

## drivers/crypto/nvt/na51090/Kconfig
```kconfig
config NVT_CRYPTO
	bool "NovaTek NA51090 Crypto Driver Support"
	depends on NVT_IVOT_SOC && NVT_IVOT_OPTEE_SUPPORT=n
	help
	  Novatek NA51090 processors have crypto engine accelerator.
	  Select this if you want to use the crypto engine for AES/DES/3DES
	  algorithms.

config NVT_HASH
	bool "NovaTek NA51090 Hash Driver Support"
	depends on NVT_IVOT_SOC && NVT_IVOT_OPTEE_SUPPORT=n
	help
	  Novatek NA51090 processors have hash engine accelerator.
	  Select this if you want to use the hash engine for SHA1/SHA256 algorithms.

config NVT_RSA
	bool "NovaTek NA51090 RSA Driver Support"
	depends on NVT_IVOT_SOC && NVT_IVOT_OPTEE_SUPPORT=n
	help
	  Novatek NA51090 processors have rsa engine accelerator.
	  Select this if you want to use the rsa engine.
```

## drivers/mtd/spiflash/Kconfig
```kconfig
choice
	prompt "Support for NVT IVOT Flash Controller"
	default NVT_SPI_NAND
	depends on NVT_IVOT_SOC

config NVT_SPI_NONE
	tristate "Not Support for NVT IVOT Flash Controller"
	depends on (NVT_IVOT_SOC)
	help
	  Disable support for Novatek NA51055 NAND Flash Controller.

config NVT_SPI_NAND
	tristate "Support for NVT IVOT NAND Flash Controller"
	depends on (NVT_IVOT_SOC)
	help
	  Enable support for Novatek NA51055 NAND Flash Controller.

config NVT_SPI_NOR
	tristate "Support for NVT IVOT NOR Flash Controller"
	depends on (NVT_IVOT_SOC)
	help
	  Enable support for Novatek NA51055 NOR Flash Controller.

config NVT_SPI_NONE
	tristate "Not Support for NVT IVOT Flash Controller"
	depends on (NVT_IVOT_SOC && TARGET_NA51068)
	help
	  Disable support for Novatek NA51068 NAND Flash Controller.

config NVT_SPI_NAND
	tristate "Support for NVT IVOT NAND Flash Controller"
	depends on (NVT_IVOT_SOC && TARGET_NA51068)
	help
	  Enable support for Novatek NA51068 NAND Flash Controller.

config NVT_SPI_NOR
	tristate "Support for NVT IVOT NOR Flash Controller"
	depends on (NVT_IVOT_SOC && TARGET_NA51068)
	help
	  Enable support for Novatek NA51068 NOR Flash Controller.
endchoice

config FLASH_ONLY_DUAL
	bool "Only Support dual mode access"
	depends on (NVT_SPI_NAND || NVT_SPI_NOR)
	help
	  Dual mode supports.
	  Force flash operations under dual mode.
```

## drivers/video/novatek/nvt_panel/Kconfig
```kconfig
#
# Panel drivers configuration
#
#
choice
	prompt "Novatek Panel Selection menu"
	default DISP_IF8B_LCD1_PW35P00_HX8238D
	depends on VIDEO_LOGO
	help
	  select panel for device object.

config DISP_IF8B_LCD1_PW35P00_HX8238D
	bool "To support PW35P00 serial panel"
	depends on VIDEO_LOGO
	help
	  Novatek Serial IF 8bit Panel PW35P00 support.

config DISP_IF8B_LCD1_AUCN01
	bool "To support AUCN01 serial panel"
	depends on VIDEO_LOGO
	help
	  Novatek Serial IF 8bit Panel AUCN01 support.

config DISP_IF8B_LCD1_TP2803
        bool "To support TP2803 serial panel"
        depends on VIDEO_LOGO
        help
          Novatek Serial IF 8bit Panel TP2803 support.

config DISP_IF8B_LCD1_PSD300
        bool "To support PSD300 serial panel"
        depends on VIDEO_LOGO
        help
          Novatek Serial IF 8bit Panel PSD300 support.

config DISP_IFDSI_LCD1_UT35067A0
        bool "To support UT35067A0  panel"
        depends on VIDEO_LOGO
        help
          Novatek Serial IF DSI Panel UT35067A0 support.

endchoice
```
